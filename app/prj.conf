## CMakeLists.txt
```
#-------------------------------------------------------------------------------
# Zephyr Example Application
#
# Copyright (c) 2021 Nordic Semiconductor ASA
# SPDX-License-Identifier: Apache-2.0

cmake_minimum_required(VERSION 3.13.1)
find_package(Zephyr REQUIRED HINTS $ENV{ZEPHYR_BASE})

project(app LANGUAGES C)

# Add QuadDrone ANO Remote Controller board support
set(BOARD_DIR ${APPLICATION_SOURCE}/boards)

# Zephyr board discovery
include_guard(GLOBAL)
if(NOT ZephyrBoard_FOUND)
  if(EXISTS ${BOARD_DIR}/vendor/${BOARD}/board.yml)
    # Board defined in QuadDrone/boards/vendor/
    set(ZephyrBoard_ROOT ${BOARD_DIR})
  elseif(EXISTS ${ZEPHYR_BASE}/boards/${BOARD}/board.yml)
    # Standard Zephyr board
    set(ZephyrBoard_ROOT ${ZEPHYR_BASE}/boards)
  endif()
  find_package(ZephyrBoard QUIET)
endif()

target_sources(app PRIVATE src/main.c)

# Include sensor drivers
zephyr_include_directories(../drivers/adc_multi)
zephyr_include_directories(../drivers/display/ssd1306_spi)

# Include ANO communication drivers
zephyr_include_directories(../drivers/uart_ano)
zephyr_include_directories(../drivers/nrf24l01_ano)
zephyr_include_directories(../drivers/protocol_ano)

# Link sensor drivers
target_sources(app PRIVATE ../drivers/adc_multi/adc_multi.c)
target_sources(app PRIVATE ../drivers/display/ssd1306_spi/ssd1306_spi.c)

# Link ANO communication drivers
target_sources(app PRIVATE ../drivers/uart_ano/uart_ano.c)
target_sources(app PRIVATE ../drivers/nrf24l01_ano/nrf24l01_ano.c)
target_sources(app PRIVATE ../drivers/protocol_ano/protocol_ano.c)

# Add OLED display driver
zephyr_library_named(ssd1306_spi)
target_sources(ssd1306_spi PRIVATE
    ${CMAKE_CURRENT_SOURCE_DIR}/drivers/display/ssd1306_spi/ssd1306_spi.c
)

# The code below locates the git index file for this repository and adds it as a dependency for
# the application VERSION file so that if the repo has a new commit added, even if no files in
# the build have changed, the application version file will be regenerated with the new git commit
find_package(Git QUIET)
if(GIT_FOUND)
  execute_process(
    COMMAND ${GIT_EXECUTABLE} rev-parse --absolute-git-dir
    WORKING_DIRECTORY .
    OUTPUT_VARIABLE application_git_dir
    OUTPUT_STRIP_TRAILING_WHITESPACE
    ERROR_STRIP_TRAILING_WHITESPACE
    ERROR_VARIABLE stderr
    RESULT_VARIABLE return_code
  )
  # If there is an error e.g. it is not a git repo, we just silently ignore it and continue
  # without a dependency, this will be the case with freestanding applications.
  if(NOT return_code)
    if(NOT "${stderr}" STREQUAL "")
      message(WARNING "Application build version git rev-parse warned: ${stderr}")
    endif()

    set_property(TARGET app_version_h PROPERTY APP_VERSION_DEPENDS ${application_git_dir}/index)
  endif()
endif()
```

## prj.conf
```kconfig
# Copyright (c) 2024 QuadDrone Project. SPDX-License-Identifier: Apache-2.0
#
# Application-specific configuration for QuadDrone ANO Remote Controller
# This layer builds on top of the board-level defconfig

# Enable console for debugging
CONFIG_LOG=y
CONFIG_LOG_RUNTIME_FILTERING=n
CONFIG_LOG_DEFAULT_LEVEL=1

# Enable LED debugging support
CONFIG_LED=y
CONFIG_LED_GPIO=y

# Configure GPIO for LED (PC13, active low)
CONFIG_GPIO=y
CONFIG_GPIO_LEDS=y

# Enable ADC for multi-channel reading
CONFIG_ADC=y
CONFIG_ADC_1=y
CONFIG_ADC_DT=y

# Enable SPI for OLED display and NRF24L01
CONFIG_SPI=y
CONFIG_SPI_BITBANG=y
CONFIG_SPI_2=y

# Enable GPIO support
CONFIG_GPIO=y

# Enable UART for ANO protocol (console already enabled)
CONFIG_UART_INTERRUPT_DRIVEN=y
CONFIG_UART_LINE_CTRL=y

# Enable CRC for ANO protocol
CONFIG_CRC=y
CONFIG_CRC_CCITT=y

# Enable logging for communication debugging
CONFIG_LOG=y
CONFIG_LOG_DEFAULT_LEVEL=2

# System configuration for better debugging
CONFIG_INIT_STACKS=y
CONFIG_PRINTK=y

# Optional: Enable specific debug modules
# CONFIG_LOG_BACKEND_UART=y
# CONFIG_UART_LINE_CTRL=y

# Clock configuration validation
CONFIG_CLOCK_MONITOR=n  # Disable to save space
```

## boards/nucleo_f302r8.overlay
```dts
/*
 * Copyright (c) 2024 QuadDrone Project. SPDX-License-Identifier: Apache-2.0
 */

/ {
	/* This overlay demonstrates additional configuration for quaddrone_remote */

	/* 72MHz clock configuration via DTS */
	clocks {
		compatible = "st,stm32f103-rcc";
		status = "okay";

		clocks {
			#address-cells = <1>;
			#size-cells = <1>;
			ranges = <0>;

			clk_hse: hse {
				#clock-cells = <0>;
				compatible = "fixed-clock";
				clock-frequency = <8000000>;
			};

			clk_pll: pll {
				#clock-cells = <0>;
				compatible = "st,stm32f103-pll-clock";
				clocks = <&clk_hse>;
				pll-m = <1>;
				pll-n = <9>;
				pll-p = <2>;
				pll-q = <7>;
				st,clkdiv = <3>; // PLL = HSE x 9 / 3 = 24MHz (prescaled)
			};
		};
	};

	&pll {
		clocks = <&clk_pll>;
		status = "okay";
	};

	/* Disable unused peripherals if needed */
	// &timers {
	//     status = "disabled";
	// };

	/* Adjust ADC sampling resolution if needed */
	// &adc1 {
	//     resolution = <12>;
	// };
};

/* Example of runtime console configuration */
/zephyr,console {
	status = "okay";
};
```

## src/main.c
```c
/*
 * Copyright (c) 2024 QuadDrone Project. SPDX-License-Identifier: Apache-2.0
 *
 * Multi-threaded Remote Controller Application
 * ADC: 1kHz sampling, Calc: 200Hz processing, Keys: 100Hz, NRF: 50Hz, OLED: 30Hz
 */

#include <zephyr/kernel.h>
#include <zephyr/logging/log.h>

#include "drivers/adc_multi/adc_multi.h"
#include "drivers/display/ssd1306_spi/ssd1306_spi.h"
#include "app/rc_processor.h"
#include "app/key_scan.h"
#include "app/battery_monitor.h"
#include "app/flight_display.h"

/* ANO protocol header */
#include "drivers/protocol_ano/protocol_ano.h"

/* ANO communication headers */
#include "drivers/uart_ano/uart_ano.h"
#include "drivers/nrf24l01_ano/nrf24l01_ano.h"

LOG_MODULE_REGISTER(main, CONFIG_LOG_DEFAULT_LEVEL);

/* Thread configurations */
#define ADC_THREAD_PRIORITY    7
#define ADC_THREAD_STACK_SIZE  256
#define CALC_THREAD_PRIORITY   8
#define CALC_THREAD_STACK_SIZE 256
#define KEY_THREAD_PRIORITY    9
#define KEY_THREAD_STACK_SIZE  256
#define NRF_TX_THREAD_PRIORITY 9
#define NRF_TX_THREAD_STACK_SIZE 256
#define OLED_THREAD_PRIORITY   10
#define OLED_THREAD_STACK_SIZE 256

/* Thread intervals */
#define ADC_INTERVAL_MS        1    /* 1kHz sampling */
#define CALC_INTERVAL_MS       5    /* 200Hz processing */
#define KEY_INTERVAL_MS        10   /* 100Hz key scanning */
#define NRF_TX_INTERVAL_MS    20   /* 50Hz transmission */
#define OLED_INTERVAL_MS       33   /* ~30Hz display */

/* Thread function prototypes */
void adc_thread(void *p1, void *p2, void *p3);
void calc_thread(void *p1, void *p2, void *p3);
void key_thread(void *p1, void *p2, void *p3);
void battery_thread(void *p1, void *p2, void *p3);
void nrf_tx_thread(void *p1, void *p2, void *p3);
void oled_thread(void *p1, void *p2, void *p3);

/* Thread data storage */
static K_THREAD_STACK_DEFINE(adc_thread_stack, ADC_THREAD_STACK_SIZE);
static K_THREAD_STACK_DEFINE(calc_thread_stack, CALC_THREAD_STACK_SIZE);
static K_THREAD_STACK_DEFINE(key_thread_stack, KEY_THREAD_STACK_SIZE);
static K_THREAD_STACK_DEFINE(battery_thread_stack, CALC_THREAD_STACK_SIZE);
static K_THREAD_STACK_DEFINE(nrf_tx_thread_stack, NRF_TX_THREAD_STACK_SIZE);
static K_THREAD_STACK_DEFINE(oled_thread_stack, OLED_THREAD_STACK_SIZE);

static struct k_thread adc_thread_data;
static struct k_thread calc_thread_data;
static struct k_thread key_thread_data;
static struct k_thread battery_thread_data;
static struct k_thread nrf_tx_thread_data;
static struct k_thread oled_thread_data;

/* Thread data storage */
static K_THREAD_DEFINE(nrf24l01_tx_thread_data, NRF_TX_THREAD_STACK_SIZE,
                        nrf_tx_thread, NULL, NULL, NULL,
                        NRF_TX_THREAD_PRIORITY, 0, 0);

/* ADC buffer for reading values */
static uint16_t adc_buffer[ADC_NUM_CHANNELS];

void adc_thread(void *p1, void *p2, void *p3)
{
    LOG_INF("ADC thread started (1kHz)");

    while (1) {
        /* Read ADC values from DMA buffer */
        adc_multi_read(adc_buffer);

        /* Apply 1kHz IIR filter: blend previous DataRaw with new ADC values */
        DataGet(adc_buffer, ADC_NUM_CHANNELS);

        k_sleep(K_MSEC(ADC_INTERVAL_MS));
    }
}

void calc_thread(void *p1, void *p2, void *p3)
{
    LOG_INF("Calc thread started (200Hz)");

    while (1) {
        /* Apply ANO scaling formulas to convert to standard RC channels */
        DataCalculate();

        k_sleep(K_MSEC(CALC_INTERVAL_MS));
    }
}

void key_thread(void *p1, void *p2, void *p3)
{
    KeyInit();
    LOG_INF("Key thread started (100Hz)");

    while (1) {
        KeyCheck();
        k_sleep(K_MSEC(KEY_INTERVAL_MS));
    }
}

void battery_thread(void *p1, void *p2, void *p3)
{
    BatteryInit();
    LOG_INF("Battery thread started (200Hz)");

    while (1) {
        BatteryCheck();
        k_sleep(K_MSEC(5));  /* 200Hz */
    }
}

void nrf_tx_thread(void *p1, void *p2, void *p3)
{
    int ret;
    LOG_INF("NRF TX thread started (50Hz)");

    /* Initialize NRF24L01 ANO driver */
    ret = nrf24l01_ano_init("SPI_2", "nrf24_ce", "nrf24_csn");
    if (ret < 0) {
        LOG_ERR("NRF24L01 ANO init failed: %d", ret);
        return;
    }

    struct ano_frame frame;
    int counter = 0;

    while (1) {
        /* Create RC data frame with 6 channels */
        ret = protocol_frame_build(&frame, ANO_CMD_RC_DATA,
                                   (uint8_t *)Data, sizeof(Data));
        if (ret < 0) {
            LOG_ERR("Protocol frame build failed: %d", ret);
            k_sleep(K_MSEC(NRF_TX_INTERVAL_MS));
            continue;
        }

        /* Send via NRF24L01 */
        ret = nrf24l01_ano_send_frame(&frame);
        if (ret < 0) {
            LOG_WRN("NRF24L01 send failed: %d", ret);
        } else {
            LOG_DBG("NRF24L01 RC data sent (ch=%d,%d,%d,%d,%d,%d)",
                    Data[0], Data[1], Data[2], Data[3], Data[4], Data[5]);
        }

        counter++;
        k_sleep(K_MSEC(NRF_TX_INTERVAL_MS));
    }
}

void oled_thread(void *p1, void *p2, void *p3)
{
    FlightDisplayInit();
    LOG_INF("OLED thread started (30Hz)");
    int frame_count = 0;

    while (1) {
        /* Update display at 30Hz */
        k_sleep(K_MSEC(OLED_INTERVAL_MS));

        FlightDisplayUpdate();
        frame_count++;
    }
}

void main(void)
{
    int ret;

    LOG_INF("QuadDrone Remote Controller - Multi-threaded RC Application");

    /* Initialize RC data structures */
    DataInit();

    /* Initialize key and battery monitoring */
    KeyInit();
    BatteryInit();

    /* Initialize multi-channel ADC */
    ret = adc_multi_init();
    if (ret < 0) {
        LOG_ERR("Failed to initialize ADC driver (%d)", ret);
        return;
    }

    /* Initialize SSD1306 OLED display */
    const struct device *spi_dev = device_get_binding("oled_spi");
    if (!spi_dev) {
        LOG_ERR("Failed to get SPI device");
        return;
    }

    ret = ssd1306_spi_init(spi_dev);
    if (ret < 0) {
        LOG_ERR("Failed to initialize OLED display (%d)", ret);
        return;
    }

    /* Initialize flight display */
    FlightDisplayInit();

    /* Create all threads with proper priorities */
    k_thread_create(&adc_thread_data, adc_thread_stack,
                    ADC_THREAD_STACK_SIZE,
                    adc_thread, NULL, NULL, NULL,
                    ADC_THREAD_PRIORITY, 0, K_NO_WAIT);

    k_thread_create(&calc_thread_data, calc_thread_stack,
                    CALC_THREAD_STACK_SIZE,
                    calc_thread, NULL, NULL, NULL,
                    CALC_THREAD_PRIORITY, 0, K_NO_WAIT);

    k_thread_create(&key_thread_data, key_thread_stack,
                    KEY_THREAD_STACK_SIZE,
                    key_thread, NULL, NULL, NULL,
                    KEY_THREAD_PRIORITY, 0, K_NO_WAIT);

    k_thread_create(&battery_thread_data, battery_thread_stack,
                    CALC_THREAD_STACK_SIZE,
                    battery_thread, NULL, NULL, NULL,
                    CALC_THREAD_PRIORITY, 0, K_NO_WAIT);

    k_thread_create(&nrf_tx_thread_data, nrf_tx_thread_stack,
                    NRF_TX_THREAD_STACK_SIZE,
                    nrf_tx_thread, NULL, NULL, NULL,
                    NRF_TX_THREAD_PRIORITY, 0, K_NO_WAIT);

    k_thread_create(&oled_thread_data, oled_thread_stack,
                    OLED_THREAD_STACK_SIZE,
                    oled_thread, NULL, NULL, NULL,
                    OLED_THREAD_PRIORITY, 0, K_NO_WAIT);

    LOG_INF("All RC threads started");

    /* Main thread just maintains the application */
    while (1) {
        k_sleep(K_SECONDS(1));
    }
}
```

## src/battery_monitor.c
```c
/*
 * Copyright (c) 2024 QuadDrone Project. SPDX-License-Identifier: Apache-2.0
 *
 * Battery Voltage Calculation Implementation
 * Implements ANO-compatible battery voltage monitoring
 */

#include "app/battery_monitor.h"

/* Battery voltage and percentage - shared with OLED thread */
float battery_voltage = 0.0f;
uint8_t battery_level_percent = 0;

/**
 * @brief Initialize battery monitoring system
 *
 * Sets battery_voltage to 0.0 and battery_level_percent to 0
 */
void BatteryInit(void)
{
    battery_voltage = 0.0f;
    battery_level_percent = 0;
}

/**
 * @brief Sample ADC and calculate battery voltage
 *
 * Called at 200Hz rate from battery thread
 * Uses DataRaw[BATTERY_ADC_CHANNEL] with ANO formula:
 * (ADC * 3.3 / 4096) * 2
 * Updates battery_voltage and battery_level_percent
 */
void BatteryCheck(void)
{
    uint16_t adc_value;

    // Read battery voltage ADC channel (PA4)
    adc_value = (uint16_t)DataRaw[BATTERY_ADC_CHANNEL];

    // ANO voltage calculation: (ADC * 3.3 / 4096) * 2
    battery_voltage = (adc_value * BATTERY_REF_VOLTAGE / 4096.0f) * BATTERY_DIVIDER_RATIO;

    // Calculate battery percentage (simple linear)
    if (battery_voltage >= BATTERY_FULL_VOLTAGE) {
        battery_level_percent = 100;
    } else if (battery_voltage <= BATTERY_EMPTY_VOLTAGE) {
        battery_level_percent = 0;
    } else {
        float percent = (battery_voltage - BATTERY_EMPTY_VOLTAGE) /
                       (BATTERY_FULL_VOLTAGE - BATTERY_EMPTY_VOLTAGE) * 100;
        battery_level_percent = (uint8_t)((percent > 100.0f) ? 100 : (percent < 0.0f) ? 0 : percent);
    }
}

/**
 * @brief Get current battery voltage
 *
 * @param voltage Pointer to store voltage value
 */
void BatteryGetVoltage(float *voltage)
{
    if (voltage) {
        *voltage = battery_voltage;
    }
}

/**
 * @brief Get battery percentage (0-100)
 *
 * @return uint8_t Battery percentage
 */
uint8_t BatteryGetPercent(void)
{
    return battery_level_percent;
}
```

## src/flight_display.c
```c
/*
 * Copyright (c) 2024 QuadDrone Project. SPDX-License-Identifier: Apache-2.0
 *
 * Flight Display Implementation for OLED Display
 * Implements ANO-style flight status display rendering
 */

#include <zephyr/device.h>
#include <zephyr/drivers/spi.h>
#include <zephyr/kernel.h>
#include <drivers/display/ssd1306_spi/ssd1306_spi.h>
#include <drivers/nrf24l01_ano/nrf24l01_ano.h>
#include "app/rc_processor.h"
#include "app/key_scan.h"
#include "app/battery_monitor.h"

/* Frame counter for display */
static int frame_count = 0;

/* Mutex for thread-safe display data access */
static struct k_mutex display_data_mutex;

/**
 * @brief Initialize OLED flight display
 */
void FlightDisplayInit(void)
{
    /* Initialize mutex for thread-safe display data access */
    k_mutex_init(&display_data_mutex);

    const struct device *dev = device_get_binding("oled_spi");
    if (!dev) {
        return;
    }

    ssd1306_spi_init(dev);
    ssd1306_spi_clear();
}

/**
 * @brief Update flight display with current data
 */
void FlightDisplayUpdate(void)
{
    char buf[MAX_ROW_CHARS];
    uint16_t temp_data[6];
    float temp_voltage;

    /* Copy shared data to local variables for thread safety */
    k_mutex_lock(&display_data_mutex, K_FOREVER);
    memcpy(temp_data, Data, sizeof(temp_data));
    temp_voltage = battery_voltage;
    k_mutex_unlock(&display_data_mutex);

    /* Clear display */
    ssd1306_spi_clear();

    /* Row 0: THR:xxxx  YAW:xxxx */
    sprintf(buf, "THR:%04d  YAW:%04d", temp_data[RC_CHANNEL_THROTTLE], temp_data[RC_CHANNEL_YAW]);
    ssd1306_spi_putstr(0, 0, buf, 6);

    /* Row 1: PIT:xxxx  ROL:xxxx */
    sprintf(buf, "PIT:%04d  ROL:%04d", temp_data[RC_CHANNEL_PITCH], temp_data[RC_CHANNEL_ROLL]);
    ssd1306_spi_putstr(0, 2, buf, 6);

    /* Row 2: BAT:x.xxV */
    sprintf(buf, "BAT:%.2fV", temp_voltage);
    ssd1306_spi_putstr(32, 4, buf, 6);

    /* Row 3: NRF status */
    if (nrf24l01_is_connected()) {
        sprintf(buf, "NRF:OK");
    } else {
        sprintf(buf, "NRF:FAIL");
    }
    ssd1306_spi_putstr(40, 6, buf, 6);

    /* Row 4: KNOB_L:xxxx */
    sprintf(buf, "L:%04d", temp_data[RC_CHANNEL_KNOB_L]);
    ssd1306_spi_putstr(0, 8, buf, 6);

    /* Row 5: KNOB_R:xxxx */
    sprintf(buf, "R:%04d", temp_data[RC_CHANNEL_KNOB_R]);
    ssd1306_spi_putstr(64, 8, buf, 6);

    /* Row 6: Frame counter */
    frame_count++;
    sprintf(buf, "F:%03d", frame_count % 1000);
    ssd1306_spi_putstr(100, 10, buf, 6);

    /* Row 7: Key status */
    sprintf(buf, "Keys:%d%d%d", KeyStatus[0], KeyStatus[1], KeyStatus[2]);
    ssd1306_spi_putstr(0, 12, buf, 6);
}
```

## src/key_scan.c
```c
/*
 * Copyright (c) 2024 QuadDrone Project. SPDX-License-Identifier: Apache-2.0
 *
 * Key Scanning Implementation
 * Implements GPIO key scanning with basic debounce for remote controller
 */

#include <stdint.h>
#include <string.h>
#include <zephyr/kernel.h>
#include <zephyr/device.h>
#include <zephyr/drivers/gpio.h>
#include <zephyr/logging/log.h>

#include "app/key_scan.h"

LOG_MODULE_REGISTER(key_scan, CONFIG_LOG_DEFAULT_LEVEL);

/* Key status array - shared with OLED thread */
uint8_t KeyStatus[NUM_KEYS];

/**
 * @brief Initialize key scanning system
 *
 * Sets KeyStatus[NUM_KEYS] array to all zeros (released state)
 */
void KeyInit(void)
{
    memset(KeyStatus, 0, sizeof(KeyStatus));
}

/**
 * @brief Scan GPIO keys and update KeyStatus
 *
 * Called at 100Hz rate from key thread
 * Reads GPIO pins PA7, PA8, PB10 with basic debounce
 * Inverts logic: 1 = released (high), 0 = pressed (low)
 */
void KeyCheck(void)
{
    const struct device *dev = device_get_binding("GPIO_0");
    if (!dev) {
        LOG_ERR("Key scan: GPIO device not available");
        return;
    }

    // Simple polling with basic debounce
    // Read GPIO pins PA7, PA8, PB10
    gpio_pin_get(dev, 7, &KeyStatus[KEY_SW_UP]);     // PA7
    gpio_pin_get(dev, 8, &KeyStatus[KEY_SW_DOWN]);   // PA8
    gpio_pin_get(dev, 10, &KeyStatus[KEY_SW_LEFT]);   // PB10

    // Invert logic: 1 = released (high), 0 = pressed (low)
    KeyStatus[KEY_SW_UP] = !KeyStatus[KEY_SW_UP];
    KeyStatus[KEY_SW_DOWN] = !KeyStatus[KEY_SW_DOWN];
    KeyStatus[KEY_SW_LEFT] = !KeyStatus[KEY_SW_LEFT];
}
```

## src/rc_processor.c
```c
/*
 * Copyright (c) 2024 QuadDrone Project. SPDX-License-Identifier: Apache-2.0
 *
 * Remote Controller Data Processing Implementation
 * Implements ANO-compatible RC data filtering and scaling
 */

#include "app/rc_processor.h"
#include <zephyr/kernel.h>

/* Data structures (defined as extern in header) */
float DataRaw[8] = {0};          /* Raw filtered ADC values */
uint16_t Data[6] = {1500};      /* Processed RC channels - neutral position */
int16_t DataTrim[6] = {0};      /* Trim offsets - v1 has no trim */

/* Mutex for thread-safe DataRaw access */
static struct k_mutex data_raw_mutex;

/**
 * @brief Initialize RC data structures
 */
void DataInit(void)
{
    /* Initialize mutex for thread-safe DataRaw access */
    k_mutex_init(&data_raw_mutex);

    /* Initialize all DataRaw values to zero */
    for (int i = 0; i < 8; i++) {
        DataRaw[i] = 0.0f;
    }

    /* Initialize Data to neutral position (1500 for all channels) */
    for (int i = 0; i < 6; i++) {
        Data[i] = 1500;
        DataTrim[i] = 0;
    }
}

/**
 * @brief Apply 1kHz IIR low-pass filter to ADC values
 *
 * ANO RemoteV1.25 DataGet formula:
 * DataRaw[i] = DataRaw[i] * 0.99 + adc_buf[i] * 0.01
 */
void DataGet(const uint16_t *adc_buf, uint8_t len)
{
    /* Protect DataRaw array access with mutex for thread safety */
    k_mutex_lock(&data_raw_mutex, K_FOREVER);
    for (int i = 0; i < len && i < 8; i++) {
        float temp = DataRaw[i];
        DataRaw[i] = temp * 0.99f + (float)adc_buf[i] * 0.01f;
    }
    k_mutex_unlock(&data_raw_mutex);
}

/**
 * @brief Convert filtered ADC values to standard RC channels
 *
 * ANO RemoteV1.25 DataCalculate formulas:
 */
void DataCalculate(void)
{
    /* ROLL: (val-1500)*0.8+1500 */
    Data[RC_CHANNEL_ROLL] = (uint16_t)((DataRaw[3] - 1500) * 0.8f + 1500);

    /* PIT: (val-1500)*0.8+1500 */
    Data[RC_CHANNEL_PITCH] = (uint16_t)((DataRaw[2] - 1500) * 0.8f + 1500);

    /* YAW: same as ROLL */
    Data[RC_CHANNEL_YAW] = (uint16_t)((DataRaw[1] - 1500) * 0.8f + 1500);

    /* THR: (val-1500)*0.85+1500-75 */
    Data[RC_CHANNEL_THROTTLE] = (uint16_t)((DataRaw[0] - 1500) * 0.85f + 1500 - 75);

    /* KNOB_L/R: direct mapping from raw values (no scaling) */
    Data[RC_CHANNEL_KNOB_L] = (uint16_t)DataRaw[5];
    Data[RC_CHANNEL_KNOB_R] = (uint16_t)DataRaw[6];
}
```
