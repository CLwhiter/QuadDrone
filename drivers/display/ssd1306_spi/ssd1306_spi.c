/*
 * Copyright (c) 2024 QuadDrone Project. SPDX-License-Identifier: Apache-2.0
 *
 * SSD1306 OLED display driver for QuadDrone Remote Controller
 * Implements 128x64 display with SPI bitbang interface
 */

#define DT_DRV_COMPAT ssd1306_spi

#include <string.h>
#include <zephyr/device.h>
#include <zephyr/drivers/gpio.h>
#include <zephyr/drivers/spi.h>
#include <zephyr/kernel.h>
#include <zephyr/logging/log.h>

#include "ssd1306_spi.h"

LOG_MODULE_REGISTER(ssd1306_spi, CONFIG_LOG_DEFAULT_LEVEL);

static struct k_mutex display_mutex;

/* Display buffer */
static uint8_t display_buffer[SSD1306_BUFFER_SIZE];

/* SPI and GPIO devices */
static const struct device *spi_dev;
static const struct device *dc_dev;
static const struct device *cs_dev;

/* Command buffer for SPI transactions */
static uint8_t cmd_buffer[16];

/* ASCII font data */
static const uint8_t font_6x8[][FONT_6X8_WIDTH] = {
    /* Font data for 6x8 ASCII characters */
    /* 0x20 - 0x7F (printable ASCII) */
    {0x00, 0x00, 0x00, 0x00, 0x00, 0x00}, /* space */
    {0x00, 0x00, 0x5F, 0x00, 0x00, 0x00}, /* ! */
    {0x00, 0x07, 0x00, 0x07, 0x00, 0x00}, /* " */
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    {0x08, 0x04, 0x08, 0x10, 0x08, 0x00}, /* ~ */
};

static const uint8_t font_8x16[][FONT_8X16_WIDTH] = {
    /* Font data for 8x16 ASCII characters */
    /* 0x20 - 0x7F (printable ASCII) */
    {0x00, 0x00, 0x00, 0x00, 0x00, 0x00, 0x00, 0x00}, /* space */
    {0x00, 0x00, 0x30, 0x30, 0x00, 0x00, 0x00, 0x00}, /* ! */
    {0x00, 0x00, 0x18, 0x18, 0x18, 0x00, 0x00, 0x00}, /* " */
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    {0x00, 0x36, 0x66, 0x66, 0x66, 0x36, 0x00, 0x00}, /* z */
};

static void ssd1306_write_cmd(uint8_t cmd)
{
    gpio_pin_set_dt(dc_dev, 0);  /* DC low for command */
    spi_write(spi_dev, &cmd, 1);
}

static void ssd1306_write_data(const uint8_t *data, size_t len)
{
    gpio_pin_set_dt(dc_dev, 1);  /* DC high for data */
    spi_write(spi_dev, data, len);
}

static void ssd1306_init_sequence(void)
{
    /* Display off */
    ssd1306_write_cmd(SSD1306_DISPLAYOFF);

    /* Set display clock divide ratio */
    ssd1306_write_cmd(SSD1306_SETDISPLAYCLOCKDIV);
    ssd1306_write_cmd(0x80);

    /* Set multiplex ratio */
    ssd1306_write_cmd(SSD1306_SETMULTIPLEX);
    ssd1306_write_cmd(0x3F);

    /* Set display offset */
    ssd1306_write_cmd(SSD1306_SETDISPLAYOFFSET);
    ssd1306_write_cmd(0x00);

    /* Set start line */
    ssd1306_write_cmd(SSD1306_SETSTARTLINE);
    ssd1306_write_cmd(0x00);

    /* Set charge pump */
    ssd1306_write_cmd(SSD1306_CHARGEPUMP);
    ssd1306_write_cmd(0x14);

    /* Set memory mode */
    ssd1306_write_cmd(SSD1306_MEMORYMODE);
    ssd1306_write_cmd(0x00);

    /* Set segment re-map */
    ssd1306_write_cmd(SSD1306_SEGREMAP);
    ssd1306_write_cmd(0x01);

    /* Set COM output scan direction */
    ssd1306_write_cmd(SSD1306_COMSCANDEC);

    /* Set COM pins */
    ssd1306_write_cmd(SSD1306_COMPINCFG);
    ssd1306_write_cmd(0x12);

    /* Set contrast */
    ssd1306_write_cmd(SSD1306_CONTRAST);
    ssd1306_write_cmd(0xCF);

    /* Set pre-charge period */
    ssd1306_write_cmd(0xD9);
    ssd1306_write_cmd(0xF1);

    /* Set VCOMH deselect level */
    ssd1306_write_cmd(0xDB);
    ssd1306_write_cmd(0x40);

    /* Set entire display ON */
    ssd1306_write_cmd(0xA4);

    /* Set normal display */
    ssd1306_write_cmd(SSD1306_SETNORMAL);

    /* Set column and row addresses */
    ssd1306_write_cmd(SSD1306_SETCOLUMNADDR);
    ssd1306_write_cmd(0);
    ssd1306_write_cmd(SSD1306_WIDTH - 1);

    ssd1306_write_cmd(SSD1306_SETROWADDR);
    ssd1306_write_cmd(0);
    ssd1306_write_cmd(SSD1306_HEIGHT - 1);

    /* Clear display */
    memset(display_buffer, 0, sizeof(display_buffer));
    ssd1306_write_data(display_buffer, sizeof(display_buffer));

    /* Display on */
    ssd1306_write_cmd(SSD1306_DISPLAYON);
}

int ssd1306_spi_init(const struct device *dev)
{
    spi_dev = dev;

    /* Initialize display mutex */
    k_mutex_init(&display_mutex);

    /* Get DC and CS GPIO devices from device tree */
    dc_dev = device_get_binding(DT_GPIO_LABEL(DT_NODELABEL(oled_dc), gpios));
    cs_dev = device_get_binding(DT_GPIO_LABEL(DT_NODELABEL(oled_cs), gpios));

    /* Check if device tree nodes are enabled */
    if (!device_is_ready(dc_dev) || !device_is_ready(cs_dev)) {
        LOG_ERR("OLED GPIO devices not ready");
        return -ENODEV;
    }

    /* Configure DC and CS pins */
    gpio_pin_configure_dt(GPIO_DT_SPEC_GET(DT_NODELABEL(oled_dc), gpios), GPIO_OUTPUT);
    gpio_pin_configure_dt(GPIO_DT_SPEC_GET(DT_NODELABEL(oled_cs), gpios), GPIO_OUTPUT);

    /* Set CS high (deselected) */
    gpio_pin_set_dt(GPIO_DT_SPEC_GET(DT_NODELABEL(oled_cs), gpios), 1);

    /* Initialize display */
    ssd1306_init_sequence();

    LOG_INF("SSD1306 OLED display initialized");
    return 0;
}

int ssd1306_spi_clear(void)
{
    memset(display_buffer, 0, sizeof(display_buffer));
    ssd1306_write_data(display_buffer, sizeof(display_buffer));
    return 0;
}

int ssd1306_spi_putstr(int x, int y, const char *str, int size)
{
    if (!str || x < 0 || y < 0 || x >= SSD1306_WIDTH || y >= 8) {
        return -EINVAL;
    }

    const uint8_t (*font)[size == 6 ? FONT_6X8_WIDTH : FONT_8X16_WIDTH];
    const uint8_t font_width = size;
    const uint8_t font_height = size;

    font = size == 6 ? font_6x8 : font_8x16;

    k_mutex_lock(&display_mutex, K_FOREVER);
    for (int i = 0; str[i] != '\0'; i++) {
        uint8_t c = str[i] - 0x20;  /* Convert ASCII to font index */

        if (c >= 128) {
            c = 0;  /* Use space for non-ASCII characters */
        }

        for (int row = 0; row < font_height; row++) {
            uint8_t byte = font[c][row];

            for (int col = 0; col < font_width; col++) {
                if (byte & (1 << col)) {
                    int px = x + col;
                    int py = y + row;

                    if (px < SSD1306_WIDTH && py < SSD1306_HEIGHT) {
                        int idx = (py / 8) * SSD1306_WIDTH + px;
                        int bit = py % 8;
                        display_buffer[idx] |= (1 << bit);
                    }
                }
            }
        }

        x += font_width;
        if (x >= SSD1306_WIDTH) {
            break;
        }
    }

    /* Write updated buffer to display */
    ssd1306_write_data(display_buffer, sizeof(display_buffer));
    k_mutex_unlock(&display_mutex);
    return 0;
}

int ssd1306_spi_set_contrast(uint8_t contrast)
{
    ssd1306_write_cmd(SSD1306_CONTRAST);
    ssd1306_write_cmd(contrast);
    return 0;
}