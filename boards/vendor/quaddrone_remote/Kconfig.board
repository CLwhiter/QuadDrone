## boards/vendor/quaddrone_remote/Kconfig.board
```kconfig
# Copyright (c) 2024 QuadDrone Project
# SPDX-License-Identifier: Apache-2.0

# Kconfig for QuadDrone ANO Remote Controller

if SOC_STM32F103C8

config BOARD_VENDOR_QUADDRONE_REMOTE
    bool "QuadDrone ANO Remote Controller Board"
    depends on BOARD_VENDOR_QUADDRONE_REMOTE
    select SOC_SERIES_STM32F1X
    select HAS_DTS
    default n
    help
      Enable support for QuadDrone ANO Remote Controller hardware based
      on STM32F103C8T6 microcontroller.

config BOARD_VENDOR_QUADDRONE_REMOTE_DEBUG
    bool "Enable QuadDrone remote debug features"
    depends on BOARD_VENDOR_QUADDRONE_REMOTE
    default n

config BOARD_VENDOR_QUADDRONE_REMOTE_LED
    bool "Enable LED support for QuadDrone remote"
    depends on BOARD_VENDOR_QUADDRONE_REMOTE
    default y

endif # SOC_STM32F103C8
```

## boards/vendor/quaddrone_remote/board.yml
```yaml
# Copyright (c) 2024 QuadDrone Project
# SPDX-License-Identifier: Apache-2.0

board:
  name: quaddrone_remote
  full_name: QuadDrone ANO Remote Controller
  vendor: vendor
  socs:
    - name: stm32f1x
    - name: stm32f103
    - name: stm32f103x8
```

## boards/vendor/quaddrone_remote/quaddrone_remote_defconfig
```kconfig
# Enable basic Zephyr features
CONFIG_ZEPHYR=y
CONFIG_SOC_STM32F103C8=y
CONFIG_BOARD_VENDOR_QUADDRONE_REMOTE=y

# Enable console
CONFIG_UART_CONSOLE=y
CONFIG_UART_LINE_CTRL=y

# Enable GPIO
CONFIG_GPIO=y

# Enable LED support
CONFIG_LED=y
CONFIG_LED_GPIO=y

# Enable clock configuration for 72MHz
CONFIG_CLOCK_CONTROL=y
CONFIG_CLOCK_CONTROL_STM32=y
CONFIG_CLOCK_CONTROL_STM32_HSE=y

# Enable ADC
CONFIG_ADC=y
CONFIG_ADC_1=y
CONFIG_ADC_NRFX_ADC=y
CONFIG_ADC_DT=y

# Enable I2C for OLED
CONFIG_I2C=y
CONFIG_I2C_1=y
CONFIG_I2C_NRFX=y
CONFIG_I2C_DT=y

# Enable SPI for NRF24L01
CONFIG_SPI=y
CONFIG_SPI_2=y
CONFIG_SPI_NRFX_SPI=y
CONFIG_SPI_DT=y

# Enable required subsystems
CONFIG_FLASH_MAP=y
CONFIG_DEVICE_POWER_MANAGEMENT=y
CONFIG_POWER=y
CONFIG_PM_DEVICE=y

# Build optimization
CONFIG_CXX=y
CONFIG_HEAP_MEM_POOL_SIZE=10240
CONFIG_STACK_SIZE=2048
CONFIG_MAIN_STACK_SIZE=2048

# Debug options (comment out for production)
# CONFIG_DEBUG=y
# CONFIG_DEBUG_ASSERT=y
```

## drivers/display/ssd1306_spi/Kconfig
```kconfig
# Copyright (c) 2024 QuadDrone Project. SPDX-License-Identifier: Apache-2.0

menuconfig SSD1306_SPI
	bool "SSD1306 OLED display driver (SPI)"
	depends on SPI
	help
	  Enable SSD1306 OLED display driver using SPI bitbang

if SSD1306_SPI

config SSD1306_SPI_INIT_PRIORITY
	int "SSD1306 driver initialization priority"
	default KERNEL_INIT_PRIORITY_DEVICE

module = SSD1306_SPI
module-str = ssd1306_spi
source "subsys/logging/Kconfig.template.log_config"

endif # SSD1306_SPI
```

## lib/control/Kconfig
```kconfig
# SPDX-License-Identifier: Apache-2.0
config CONTROL
    bool "Support for control library"
    default y
    help
      This option enables the 'control' library for PID controllers

config CONTROL_PID_IMAX_DEFAULT
    int "Default PID integral max"
    depends on CONTROL
    default 32768
    help
      Default maximum integral value for PID controller
```

## lib/filter/Kconfig
```kconfig
# SPDX-License-Identifier: Apache-2.0
config FILTER
    bool "Support for filter library"
    default y
    help
      This option enables the 'filter' library for digital filters

config FILTER_LPF_ORDER
    int "Default LPF order"
    depends on FILTER
    default 1
    help
      Default order for low-pass filter (1 or 2)
```

## lib/math/Kconfig
```kconfig
# SPDX-License-Identifier: Apache-2.0
config MATH
    bool "Support for math library"
    default y
    help
      This option enables the 'math' library for Vector3, Matrix3, and Quaternion operations

config MATH_VECTOR3F_OPTIMIZATION
    bool "Enable Vector3f optimizations"
    depends on MATH
    default y
    help
      This option enables specific optimizations for float vector operations
```
